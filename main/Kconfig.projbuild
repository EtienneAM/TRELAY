## main/Kconfig.projbuild
```kconfig
menu "TRELAY Configuration"

    config TRELAY_GPIO_PIN
        int "Relay GPIO pin"
        default 5
        range 0 23
        help
            GPIO pin connected to the relay control signal.
            Default is GPIO5 for DFRobot Beetle ESP32-C6.
            Avoid: GPIO9 (boot button), GPIO12-13 (USB), GPIO15 (onboard LED).

    config TRELAY_ACTIVE_HIGH
        bool "Relay active HIGH"
        default y
        help
            Set y if the relay triggers when the GPIO is HIGH (most modules).
            Set n if the relay triggers when the GPIO is LOW (active-low modules).

    config TRELAY_DEVICE_TYPE
        int "Default device type (0=On/Off switch, 1=Door lock)"
        default 0
        range 0 1
        help
            0 = Generic On/Off plug-in unit (shows as switch/outlet in Home Assistant).
            1 = Door Lock (shows as a lock in Home Assistant, supports Lock/Unlock).
            Can be changed at runtime via serial: set type on_off | door_lock

    config TRELAY_AUTO_REVERT_S
        int "On/Off switch: auto-revert to off after N seconds (0=disabled)"
        default 0
        range 0 3600
        help
            For the on_off switch device type only.
            When enabled, the relay automatically turns off N seconds after being turned on.
            0 disables auto-revert. Can be changed at runtime via serial: set revert <n>

    config TRELAY_AUTO_RELOCK_TIME_S
        int "Door lock: AutoRelockTime in seconds (1-10)"
        default 3
        range 1 10
        help
            Default value for the Matter AutoRelockTime attribute when using the
            door_lock device type. The lock will automatically re-lock this many
            seconds after being unlocked. Clamped to [1, 10] at runtime.
            This sets the compiled-in default; users can override via the serial
            console (set revert <n>) or via a Matter controller.

endmenu
```
